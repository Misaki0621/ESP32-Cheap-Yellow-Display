## Examples/ESP-IDF/STOCK_MONI/sdkconfig.defaults
```kconfig
CONFIG_IDF_TARGET="esp32"
CONFIG_ESPTOOLPY_FLASHSIZE_4MB=y
CONFIG_PARTITION_TABLE_SINGLE_APP_LARGE=y
CONFIG_LV_THEME_DEFAULT_DARK=y
CONFIG_XPT2046_INTERRUPT_MODE=y
CONFIG_ESP_TASK_WDT=n
CONFIG_ESP_MAIN_TASK_STACK_SIZE=8192
```
